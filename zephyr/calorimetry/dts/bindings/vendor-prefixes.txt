## zephyr/waveshare-esp32-s3-1.47B/boards/waveshare/esp32s3_lcd_1_47b/Kconfig.defconfig
```kconfig
# SPDX-FileCopyrightText: Copyright The Zephyr Project Contributors
# SPDX-License-Identifier: Apache-2.0

if BOARD_ESP32S3_LCD_1_47B

if DISPLAY

if LVGL

choice LV_COLOR_DEPTH
	default LV_COLOR_DEPTH_16
endchoice

config LV_COLOR_16_SWAP
	default y

endif # LVGL

endif # DISPLAY

endif # BOARD_ESP32S3_LCD_1_47B
```

## zephyr/waveshare-esp32-s3-1.47B/boards/waveshare/esp32s3_lcd_1_47b/Kconfig.esp32s3_lcd_1_47b
```kconfig
# SPDX-FileCopyrightText: Copyright The Zephyr Project Contributors
# SPDX-License-Identifier: Apache-2.0

config BOARD_ESP32S3_LCD_1_47B
	select SOC_ESP32S3_R8
	select SOC_ESP32S3_PROCPU if BOARD_ESP32S3_LCD_1_47B_ESP32S3_PROCPU
	select SOC_ESP32S3_APPCPU if BOARD_ESP32S3_LCD_1_47B_ESP32S3_APPCPU
```

## zephyr/waveshare-esp32-s3-1.47B/boards/waveshare/esp32s3_lcd_1_47b/board.yml
```yaml
board:
  name: esp32s3_lcd_1_47b
  full_name: ESP32-S3-LCD-1.47B
  vendor: waveshare
  socs:
  - name: esp32s3
```
